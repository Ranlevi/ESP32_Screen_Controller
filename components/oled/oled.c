#include "oled.h"

#include <string.h>

#include "driver/i2c_master.h"
#include "esp_lcd_panel_io.h"
#include "esp_lcd_panel_ops.h"
#include "esp_lcd_panel_vendor.h"
#include "esp_log.h"

// ---------------------------------------------------------------------------
// Hardware configuration
// ---------------------------------------------------------------------------

#define OLED_I2C_SDA_GPIO       21
#define OLED_I2C_SCL_GPIO       22
#define OLED_I2C_PORT           I2C_NUM_0
#define OLED_I2C_FREQ_HZ        400000      // SSD1306 supports fast-mode (400 kHz)
#define OLED_I2C_ADDR           0x3C        // Most common SSD1306 address (alt: 0x3D)

#define OLED_PIXEL_WIDTH        128
#define OLED_PIXEL_HEIGHT       64

// ---------------------------------------------------------------------------
// Font — 8x8 monochrome bitmap, printable ASCII (0x20 – 0x7E)
// Each character is 8 bytes, one byte per row, MSB = leftmost pixel.
// Source: public-domain IBM CP437 8x8 font.
// ---------------------------------------------------------------------------

#define FONT_CHAR_WIDTH         8
#define FONT_CHAR_HEIGHT        8
#define FONT_FIRST_CHAR         0x20
#define FONT_LAST_CHAR          0x7E
#define FONT_NUM_CHARS          (FONT_LAST_CHAR - FONT_FIRST_CHAR + 1)

static const uint8_t s_font8x8[FONT_NUM_CHARS][FONT_CHAR_HEIGHT] = {
    { 0x00, 0x00, 0x00, 0x00, 0x00, 0x00, 0x00, 0x00 }, // ' '
    { 0x18, 0x3C, 0x3C, 0x18, 0x18, 0x00, 0x18, 0x00 }, // '!'
    { 0x36, 0x36, 0x00, 0x00, 0x00, 0x00, 0x00, 0x00 }, // '"'
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    { 0x6E, 0x3B, 0x00, 0x00, 0x00, 0x00, 0x00, 0x00 }, // '~'
};

// ---------------------------------------------------------------------------
// Framebuffer
// 128 pixels wide, 64 pixels tall, 1 bit per pixel = 1024 bytes.
// Laid out in SSD1306 page order: 8 pages of 128 bytes, one byte per column,
// LSB = topmost pixel in page.
//
// The framebuffer concept:
// A copy of the display in RAM. You write to the buffer and then call flush()
// to push the data over I2C.
// The reason is that you need to send the whole display even if you change 
// only one character. The buffer allows you to compose multiple changes and
// send them all in one flush() call. 
// ---------------------------------------------------------------------------

#define FB_SIZE     (OLED_PIXEL_WIDTH * OLED_PIXEL_HEIGHT / 8)

static uint8_t s_framebuffer[FB_SIZE];

// ---------------------------------------------------------------------------
// Module state
// ---------------------------------------------------------------------------

static const char *TAG = "oled";

static esp_lcd_panel_handle_t s_panel       = NULL;
static bool                   s_initialized = false;

// ---------------------------------------------------------------------------
// Internal helpers
// ---------------------------------------------------------------------------

//  Writes s_framebuffer to the display.
static esp_err_t flush(void)
{
    //  draw_bitmap expects: x_start, y_start, x_end (exclusive), y_end (exclusive), data
    return esp_lcd_panel_draw_bitmap(
        s_panel,
        0, 0,
        OLED_PIXEL_WIDTH, OLED_PIXEL_HEIGHT,
        s_framebuffer);
}

//  Blits one character glyph into s_framebuffer at pixel position (x, y).
//  y must be page-aligned (multiple of 8) for correct rendering.
static void blit_char(int x, int y, char c)
{
    if (c < FONT_FIRST_CHAR || c > FONT_LAST_CHAR) {
        c = ' ';
    }

    const uint8_t *glyph = s_font8x8[(uint8_t)(c - FONT_FIRST_CHAR)];
    int page = y / FONT_CHAR_HEIGHT;

    for (int col = 0; col < FONT_CHAR_WIDTH; col++) {
        int px = x + col;
        if (px >= OLED_PIXEL_WIDTH) {
            break;
        }
        //  The font is row-major: glyph[row] has one bit per column, LSB = left.
        //  The SSD1306 framebuffer is column-major: each byte is a vertical strip
        //  of 8 pixels within a page, LSB = top pixel.
        //  Transpose: for each output column, collect one bit from each font row.
        uint8_t col_byte = 0;
        for (int row = 0; row < FONT_CHAR_HEIGHT; row++) {
            if (glyph[row] & (1u << col)) {
                col_byte |= (uint8_t)(1u << row);
            }
        }
        s_framebuffer[page * OLED_PIXEL_WIDTH + px] = col_byte;
    }
}

// ---------------------------------------------------------------------------
// Public API
// ---------------------------------------------------------------------------

/*
    Oled screen abstraction explained:
    There are three layers, each built on top of the previous.
    - bus_handle: lowest layer - raw I2C bus, created by i2c_new_master_bus().
      Sends bytes over I2C.
    - io_handle: created by esp_lcd_new_panel_io_i2c(). Display-oriented I2C
      session: has the device address, and handles the framing esp_lcd expects 
      (command vs. data mode)
    - s_panel: created by esp_lcd_new_panel_ssd1306. The SSD1306 driver itself: 
      understands the SSD1306 commands - how to reset, init, etc. Exposes the 
      esp_lcd_panel_* API (reset, init, draw_bitmap, etc.) that the app actually
      calls.
*/
esp_err_t oled_init(void)
{
    //Prevents calling the function twice.
    if (s_initialized) {
        return ESP_OK;
    }

    // --- I2C master bus ---
    i2c_master_bus_config_t bus_cfg = {
        .i2c_port      = OLED_I2C_PORT,
        .sda_io_num    = OLED_I2C_SDA_GPIO,
        .scl_io_num    = OLED_I2C_SCL_GPIO,
        .clk_source    = I2C_CLK_SRC_DEFAULT,
        .glitch_ignore_cnt = 7,
        .flags.enable_internal_pullup = true,
    };

    i2c_master_bus_handle_t bus_handle;
    esp_err_t err = i2c_new_master_bus(&bus_cfg, &bus_handle);
    if (err != ESP_OK) {
        ESP_LOGE(TAG, "i2c_master_bus_create failed: %s", esp_err_to_name(err));
        return err;
    }

    // --- LCD panel IO (I2C transport) ---
    esp_lcd_panel_io_handle_t io_handle;
    esp_lcd_panel_io_i2c_config_t io_cfg = {
        .dev_addr            = OLED_I2C_ADDR,
        .scl_speed_hz        = OLED_I2C_FREQ_HZ,
        .control_phase_bytes = 1,
        .dc_bit_offset       = 6,
        .lcd_cmd_bits        = 8,
        .lcd_param_bits      = 8,
    };

    //Create LCD panel IO handle
    err = esp_lcd_new_panel_io_i2c(bus_handle, &io_cfg, &io_handle);
    if (err != ESP_OK) {
        ESP_LOGE(TAG, "esp_lcd_new_panel_io_i2c failed: %s", esp_err_to_name(err));
        return err;
    }

    // --- SSD1306 panel driver ---
    esp_lcd_panel_dev_config_t panel_cfg = {
        .bits_per_pixel = 1,
        .reset_gpio_num = -1,   // No hard-reset GPIO wired on this board
    };

    err = esp_lcd_new_panel_ssd1306(io_handle, &panel_cfg, &s_panel);
    if (err != ESP_OK) {
        ESP_LOGE(TAG, "esp_lcd_new_panel_ssd1306 failed: %s", esp_err_to_name(err));
        return err;
    }

    err = esp_lcd_panel_reset(s_panel);
    if (err != ESP_OK) {
        ESP_LOGE(TAG, "esp_lcd_panel_reset failed: %s", esp_err_to_name(err));
        return err;
    }

    err = esp_lcd_panel_init(s_panel);
    if (err != ESP_OK) {
        ESP_LOGE(TAG, "esp_lcd_panel_init failed: %s", esp_err_to_name(err));
        return err;
    }

    err = esp_lcd_panel_disp_on_off(s_panel, true);
    if (err != ESP_OK) {
        ESP_LOGE(TAG, "esp_lcd_panel_disp_on_off failed: %s", esp_err_to_name(err));
        return err;
    }

    memset(s_framebuffer, 0, sizeof(s_framebuffer));

    s_initialized = true;
    ESP_LOGI(TAG, "SSD1306 initialized (%dx%d)", OLED_PIXEL_WIDTH, OLED_PIXEL_HEIGHT);
    return ESP_OK;
}

esp_err_t oled_clear(void)
{
    if (!s_initialized) {
        return ESP_ERR_INVALID_STATE;
    }

    memset(s_framebuffer, 0, sizeof(s_framebuffer));
    return flush();
}

esp_err_t oled_show_text(int col, int row, const char *text)
{
    if (!s_initialized) {
        return ESP_ERR_INVALID_STATE;
    }

    if (text == NULL) {
        return ESP_ERR_INVALID_ARG;
    }

    //  row must be page-aligned; silently round down.
    int y = (row / FONT_CHAR_HEIGHT) * FONT_CHAR_HEIGHT;

    int x = col;
    for (const char *p = text; *p != '\0'; p++) {
        if (x + FONT_CHAR_WIDTH > OLED_PIXEL_WIDTH) {
            break;  // clip — don't wrap
        }
        blit_char(x, y, *p); //Insert text into the framebuffer.
        x += FONT_CHAR_WIDTH;
    }

    return flush(); //actual writing to the display.
}
